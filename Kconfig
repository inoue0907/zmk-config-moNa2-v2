## Kconfig
```kconfig
config ZMK_BEHAVIOR_IME_KEY_PRESS
    bool "Key press that only fires while IME is on"
    default y
    depends on DT_HAS_ZMK_BEHAVIOR_IME_KEY_PRESS_ENABLED

config ZMK_IPAD_MODE
    bool "Activate a layer while the iPad BLE profile is selected"
    default y
    depends on DT_HAS_ZMK_IPAD_MODE_ENABLED && ZMK_BLE
```

## dts/bindings/behaviors/zmk,behavior-ime-key-press.yaml
```yaml
# SPDX-License-Identifier: MIT

description: |
  Key press that is only sent while the IME is believed to be on.
  IME state is tracked from LANGUAGE_1 (IME on) / LANGUAGE_2 (IME off) key presses.

compatible: "zmk,behavior-ime-key-press"

include: one_param.yaml
```

## dts/bindings/zmk,ipad-mode.yaml
```yaml
# SPDX-License-Identifier: MIT

description: |
  Activates a layer while the selected output is a specific BLE profile.
  Used to swap modifiers and shortcuts for iPad when its BT profile is selected.

compatible: "zmk,ipad-mode"

properties:
  profile:
    type: int
    required: true
    description: BLE profile index (0-based) that is connected to the iPad
  layer:
    type: int
    required: true
    description: Layer to keep active while that profile is the output
```
